## ChobotCamOS/Config.in
```kconfig
menu "Chobot packages"
source "$BR2_EXTERNAL_CHOBOT_PATH/package/chobotcam/Config.in"
endmenu
```

## ChobotCamOS/package/chobotcam/Config.in
```kconfig
config BR2_PACKAGE_CHOBOTCAM
    bool "ChobotCam native V4L2 streaming daemon"
    depends on BR2_TOOLCHAIN_HAS_THREADS
    help
      Two UVC MJPEG cameras with one GPIO-selected HTTP stream.
```
